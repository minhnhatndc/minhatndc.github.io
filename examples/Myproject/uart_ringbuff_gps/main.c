
#include <stdbool.h>
#include <stdint.h>
#include <stdio.h>
#include "gps_app.h"
// include Uart library
#include "app_uart.h"
#include "app_error.h"
#include "nrf_delay.h"
#include "nrf.h"
#include "bsp.h"
#include "nrf_uart.h"
#include "nrf_drv_uart.h"

#include "ringuart.h"
#include "nrf_ringbuf.h"
#include "gps_app.h"
#define UART_TX_BUFF_SIZE 128
#define UART_RX_BUF_SIZE 128
#define  UART_HWFC APP_UART_FLOW_CONTROL_DISABLED


//================================================

//======================================================
#define  sizebuff 256
char gga_data[128];
char rmc_data[128];
GPSSTRUCT gpsData;
uint8_t buffer[GPS_BUFFER];
uint8_t t;
int FlagGGA =0;
int FlagRMC=0;
//========================================================

//=========================================================

//=======================================================



void uart_err_handle(app_uart_evt_t *p_event){

 switch(p_event->evt_type){ 
    case (APP_UART_COMMUNICATION_ERROR):
    {
        APP_ERROR_HANDLER(p_event->data.error_communication);
    
    break;
    }
    case (APP_UART_FIFO_ERROR):
    {
        APP_ERROR_HANDLER(p_event->data.error_code);
    break;}
     case APP_UART_DATA_READY:
     {
      app_uart_get(&t);
      RingBufferPut(t);
      printf("%c", t);
     break;
     }
     default:
     {
     break;
     }
    }     
}

//====================================================
static void uart_init(void){
ret_code_t err_code;
app_uart_comm_params_t comm_params ={
  RX_PIN_NUMBER,
  TX_PIN_NUMBER,
  RTS_PIN_NUMBER,
  CTS_PIN_NUMBER,
  UART_HWFC,
  false,
  NRF_UART_BAUDRATE_9600
  };
APP_UART_FIFO_INIT(&comm_params,UART_RX_BUF_SIZE,UART_TX_BUFF_SIZE,uart_err_handle,APP_IRQ_PRIORITY_LOWEST,err_code);
APP_ERROR_CHECK(err_code);

}
//====================================================================

// Main Funtion
int main(void)
{ 
  uart_init();
  RingBufferInit();
    // Do task
    while (true)
     {
        if(Wait_for("GGA") == 1)
          {
            Copy_upto("*",gga_data);
            if(decodeGGA(gga_data, &gpsData.ggastruct) == 0) FlagGGA = 2;
            else FlagGGA = 1;
          }
          nrf_delay_ms(5000);

        if(Wait_for("RMC")==1)
          {
            Copy_upto("*",rmc_data);
            if(decodeRMC(rmc_data,&gpsData.rmcstruct) == 0 ) FlagRMC = 2;
            else FlagRMC = 1;
          }
          nrf_delay_ms(5000);
      }
    }


/** @} */

















































































































































































































































































































































































































































































































































































































































































































































































































































































































































































































































































































































































































































































































































































































































































































































































































































































































































































































































































































































































































































































































































































































































































































































































































































































































































































































































































  


